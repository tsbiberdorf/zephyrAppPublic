## CMakeLists.txt
```
# SPDX-License-Identifier: Apache-2.0

cmake_minimum_required(VERSION 3.20.0)

find_package(Zephyr REQUIRED HINTS $ENV{ZEPHYR_BASE})
project(nucleoL476_USART3Echo)

target_sources(app PRIVATE
	src/main.c
	src/gpioHandler.c
	src/shellCommands.c
	src/dvkUart.c
)
```

## prj.conf
```kconfig
# Enable GPIO
CONFIG_GPIO=y

# Enable console for printk output
CONFIG_CONSOLE=y
CONFIG_UART_CONSOLE=y

# enable RTT output
CONFIG_RTT_CONSOLE=n
CONFIG_USE_SEGGER_RTT=n

# Optional: Enable serial output
CONFIG_SERIAL=y
CONFIG_PRINTK=y

# Enable shell subsystem
CONFIG_SHELL=y
CONFIG_SHELL_BACKEND_SERIAL=y
CONFIG_SHELL_PROMPT_UART="nucleo:~$ "
CONFIG_KERNEL_SHELL=y

# Enable UART for USART3
CONFIG_UART_INTERRUPT_DRIVEN=y

# Enable debug support
CONFIG_DEBUG=y
CONFIG_DEBUG_OPTIMIZATIONS=y
CONFIG_DEBUG_THREAD_INFO=y
CONFIG_THREAD_NAME=y
CONFIG_THREAD_MONITOR=y
```

## boards/nucleo_l476rg.overlay
```dts
/*
 * Copyright (c) 2025
 * SPDX-License-Identifier: Apache-2.0
 *
 * Board overlay file for Nucleo L476RG
 * Enables USART3 with default pins PB10 (TX) and PB11 (RX)
 */

&usart3 {
	status = "okay";
};
```

## src/main.c
```c
/*
 * Copyright (c) 2025
 * SPDX-License-Identifier: Apache-2.0
 */

#include <zephyr/kernel.h>
#include "gpioHandler.h"
#include "shellCommands.h"
#include "dvkUart.h"
#include "main.h"

int main(void)
{
	int ret;

	/* Initialize GPIO handler */
	ret = gpioHandlerInit();
	if (ret < 0) {
		return -1;
	}

	/* Initialize shell commands */
	shellCommandsInit();

	/* Initialize UART handler */
	ret = dvkUartInit();
	if (ret < 0) {
		return -1;
	}

	/* Print application banner */
	printk("\n");
	printk("========================================\n");
	printk("Nucleo-L476RG USART3 Echo with LED Control %d.%d.%d.%d\n",
	       MAJOR_VERSION, MINOR_VERSION, PATCH_VERSION, BUILD_VERSION);
	printk("========================================\n");
	printk("\nAvailable commands:\n");
	printk("  led on          - Turn LED on\n");
	printk("  led off         - Turn LED off\n");
	printk("  led flash [ms]  - Flash LED (optional period in ms)\n");
	printk("  led status      - Show current LED status\n");
	printk("\nDefault mode: Flashing at %d ms\n", gpioHandlerGetFlashPeriod());
	printk("\nUSART3 Echo: Connect to PC3 (RX) and PC4 (TX)\n");
	printk("========================================\n\n");

	/* Main thread can sleep - LED control is handled by the dedicated thread */
	while (1) {
		k_sleep(K_FOREVER);
	}

	return 0;
}
```

## src/dvkUart.c
```c
/*
 * Copyright (c) 2025
 * SPDX-License-Identifier: Apache-2.0
 */

#include "dvkUart.h"
#include <zephyr/kernel.h>
#include <zephyr/device.h>
#include <zephyr/drivers/uart.h>
#include <string.h>

/* Get USART3 device from device tree */
#define UART_DEVICE_NODE DT_NODELABEL(usart3)

static const struct device *uartDev = DEVICE_DT_GET(UART_DEVICE_NODE);

/* Ring buffer for received data */
#define UART_RX_BUF_SIZE 256
static uint8_t rxBuffer[UART_RX_BUF_SIZE];
static uint32_t rxHead = 0;
static uint32_t rxTail = 0;

/* Semaphore to signal data received */
K_SEM_DEFINE(rxDataSem, 0, 1);

/**
 * @brief UART interrupt callback
 * Called when UART data is received
 */
static void uartIsrCallback(const struct device *dev, void *userData)
{
	uint8_t c;

	if (!uart_irq_update(uartDev)) {
		return;
	}

	if (!uart_irq_rx_ready(uartDev)) {
		return;
	}

	/* Read all available bytes */
	while (uart_fifo_read(uartDev, &c, 1) == 1) {
		/* Store in ring buffer */
		uint32_t nextHead = (rxHead + 1) % UART_RX_BUF_SIZE;

		if (nextHead != rxTail) {
			rxBuffer[rxHead] = c;
			rxHead = nextHead;

			/* Signal that data is available */
			k_sem_give(&rxDataSem);
		} else {
			/* Buffer overflow - data lost */
			printk("UART RX buffer overflow\n");
		}
	}
}

int dvkUartInit(void)
{
	if (!device_is_ready(uartDev)) {
		printk("Error: UART device %s not ready\n", uartDev->name);
		return -1;
	}

	/* Configure interrupt-driven UART */
	uart_irq_callback_user_data_set(uartDev, uartIsrCallback, NULL);
	uart_irq_rx_enable(uartDev);

	printk("UART Handler initialized: %s\n", uartDev->name);
	printk("USART3 configured on PC3 (RX) and PC4 (TX) at 115200 baud\n");

	return 0;
}

int dvkUartSendString(const char *str)
{
	if (!str) {
		return -1;
	}

	size_t len = strlen(str);
	for (size_t i = 0; i < len; i++) {
		uart_poll_out(uartDev, str[i]);
	}

	return 0;
}

/**
 * @brief Get a character from the receive buffer
 * @param c Pointer to store the received character
 * @return 0 on success, -1 if buffer is empty
 */
static int uartGetChar(uint8_t *c)
{
	if (rxTail == rxHead) {
		return -1;  /* Buffer empty */
	}

	*c = rxBuffer[rxTail];
	rxTail = (rxTail + 1) % UART_RX_BUF_SIZE;

	return 0;
}

/* UART echo task */
void uartEchoTask(void)
{
	uint8_t c;
	char welcomeMsg[] = "\r\n=== USART3 Echo Ready ===\r\n";
	char prompt[] = "Type characters to echo them back...\r\n";

	/* Send welcome message */
	dvkUartSendString(welcomeMsg);
	dvkUartSendString(prompt);

	while (1) {
		/* Wait for data to be available */
		k_sem_take(&rxDataSem, K_FOREVER);

		/* Process all available characters */
		while (uartGetChar(&c) == 0) {
			/* Echo the character back */
			uart_poll_out(uartDev, c);

			/* Handle special characters */
			if (c == '\r') {
				/* Echo newline after carriage return */
				uart_poll_out(uartDev, '\n');
			}

			/* Future expansion: Parse commands here
			 * For now, just echo. In the future, you can:
			 * - Accumulate characters into a command buffer
			 * - Parse on '\r' or '\n'
			 * - Execute commands and send responses
			 */
		}
	}
}

/* Define the UART task thread */
K_THREAD_DEFINE(uartThread, 2048, uartEchoTask, NULL, NULL, NULL, 7, 0, 0);
```

## src/dvkUart.h
```c
/*
 * Copyright (c) 2025
 * SPDX-License-Identifier: Apache-2.0
 */

#ifndef DVK_UART_H
#define DVK_UART_H

#include <zephyr/kernel.h>
#include <zephyr/device.h>

/**
 * @brief Initialize the UART handler for USART3
 * @return 0 on success, negative error code on failure
 */
int dvkUartInit(void);

/**
 * @brief UART echo task entry point (called by Zephyr)
 * This task handles receiving and echoing data on USART3
 */
void uartEchoTask(void);

/**
 * @brief Send a string over UART
 * @param str The null-terminated string to send
 * @return 0 on success, negative error code on failure
 */
int dvkUartSendString(const char *str);

#endif /* DVK_UART_H */
```

## src/main.h
```c
#ifndef MAIN_H
#define MAIN_H 

#define MAJOR_VERSION 1
#define MINOR_VERSION 0 
#define PATCH_VERSION 0
#define BUILD_VERSION 0


#endif /* MAIN_H */
```

## src/shellCommands.c
```c
/*
 * Copyright (c) 2025
 * SPDX-License-Identifier: Apache-2.0
 */

#include "shellCommands.h"
#include "gpioHandler.h"
#include <zephyr/shell/shell.h>
#include <stdlib.h>
#include "main.h"

/* Shell command: led on */
static int cmdLedOn(const struct shell *sh, size_t argc, char **argv)
{
	gpioHandlerSetMode(LED_MODE_ON);
	shell_print(sh, "LED set to ON");
	return 0;
}

/* Shell command: led off */
static int cmdLedOff(const struct shell *sh, size_t argc, char **argv)
{
	gpioHandlerSetMode(LED_MODE_OFF);
	shell_print(sh, "LED set to OFF");
	return 0;
}

/* Shell command: led flash [period_ms] */
static int cmdLedFlash(const struct shell *sh, size_t argc, char **argv)
{
	if (argc > 1) {
		int period = atoi(argv[1]);
		if (period < 100 || period > 10000) {
			shell_error(sh, "Period must be between 100 and 10000 ms");
			return -1;
		}
		gpioHandlerSetFlashPeriod(period);
	}

	gpioHandlerSetMode(LED_MODE_FLASHING);
	shell_print(sh, "LED set to FLASHING (period: %d ms)",
		    gpioHandlerGetFlashPeriod());
	return 0;
}

/* Shell command: led status */
static int cmdLedStatus(const struct shell *sh, size_t argc, char **argv)
{
	const char *modeStr;
	enum LedMode mode = gpioHandlerGetMode();

	switch (mode) {
	case LED_MODE_OFF:
		modeStr = "OFF";
		break;
	case LED_MODE_ON:
		modeStr = "ON";
		break;
	case LED_MODE_FLASHING:
		modeStr = "FLASHING";
		break;
	default:
		modeStr = "UNKNOWN";
		break;
	}

	shell_print(sh, "LED Mode: %s", modeStr);
	if (mode == LED_MODE_FLASHING) {
		shell_print(sh, "Flash Period: %d ms", gpioHandlerGetFlashPeriod());
	}

	return 0;
}

/* Register shell commands */
SHELL_STATIC_SUBCMD_SET_CREATE(ledCommands,
	SHELL_CMD(on, NULL, "Turn LED on", cmdLedOn),
	SHELL_CMD(off, NULL, "Turn LED off", cmdLedOff),
	SHELL_CMD(flash, NULL, "Set LED to flashing mode [period_ms]", cmdLedFlash),
	SHELL_CMD(status, NULL, "Show LED status", cmdLedStatus),
	SHELL_SUBCMD_SET_END
);

SHELL_CMD_REGISTER(led, &ledCommands, "LED control commands", NULL);

/* Shell command: version */
static int cmdVersion(const struct shell *sh, size_t argc, char **argv)
{
	shell_print(sh, "Version: %d.%d.%d.%d", MAJOR_VERSION, MINOR_VERSION, PATCH_VERSION, BUILD_VERSION);
	return 0;
}

SHELL_CMD_REGISTER(version, NULL, "Code Version", cmdVersion);

void shellCommandsInit(void)
{
	/* Shell commands are automatically registered via SHELL_CMD_REGISTER macro */
	printk("Shell commands registered\n");
}
```

## src/shellCommands.h
```c
/*
 * Copyright (c) 2025
 * SPDX-License-Identifier: Apache-2.0
 */

#ifndef SHELL_COMMANDS_H
#define SHELL_COMMANDS_H

/**
 * @brief Initialize and register shell commands
 */
void shellCommandsInit(void);

#endif /* SHELL_COMMANDS_H */
```
