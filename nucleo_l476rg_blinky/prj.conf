## CMakeLists.txt
```
# SPDX-License-Identifier: Apache-2.0

cmake_minimum_required(VERSION 3.20.0)

find_package(Zephyr REQUIRED HINTS $ENV{ZEPHYR_BASE})
project(nucleo_l476rg_blinky)

target_sources(app PRIVATE
	src/main.c
	src/gpioHandler.c
	src/shellCommands.c
)
```

## prj.conf
```kconfig
# Enable GPIO
CONFIG_GPIO=y

# Enable console for printk output
CONFIG_CONSOLE=y
CONFIG_UART_CONSOLE=y

# Optional: Enable serial output
CONFIG_SERIAL=y
CONFIG_PRINTK=y

# Enable shell subsystem
CONFIG_SHELL=y
CONFIG_SHELL_BACKEND_SERIAL=y
CONFIG_SHELL_PROMPT_UART="nucleo:~$ "
CONFIG_KERNEL_SHELL=y
```

## src/main.c
```c
/*
 * Copyright (c) 2025
 * SPDX-License-Identifier: Apache-2.0
 */

#include <zephyr/kernel.h>
#include "gpioHandler.h"
#include "shellCommands.h"
#include "main.h"

int main(void)
{
	int ret;

	/* Initialize GPIO handler */
	ret = gpioHandlerInit();
	if (ret < 0) {
		return -1;
	}

	/* Initialize shell commands */
	shellCommandsInit();

	/* Print application banner */
	printk("\n");
	printk("========================================\n");
	printk("Nucleo-L476RG LED Control with Shell %d.%d.%d.%d\n",
	       MAJOR_VERSION, MINOR_VERSION, PATCH_VERSION, BUILD_VERSION);
	printk("========================================\n");
	printk("\nAvailable commands:\n");
	printk("  led on          - Turn LED on\n");
	printk("  led off         - Turn LED off\n");
	printk("  led flash [ms]  - Flash LED (optional period in ms)\n");
	printk("  led status      - Show current LED status\n");
	printk("\nDefault mode: Flashing at %d ms\n", gpioHandlerGetFlashPeriod());
	printk("========================================\n\n");

	/* Main thread can sleep - LED control is handled by the dedicated thread */
	while (1) {
		k_sleep(K_FOREVER);
	}

	return 0;
}
```

## src/gpioHandler.c
```c
/*
 * Copyright (c) 2025
 * SPDX-License-Identifier: Apache-2.0
 */

#include "gpioHandler.h"
#include <zephyr/kernel.h>
#include <zephyr/drivers/gpio.h>

/* The devicetree node identifier for the "led0" alias */
#define LED0_NODE DT_ALIAS(led0)

/*
 * A build error on this line means your board is unsupported.
 * For Nucleo-L476RG, led0 is the green user LED (LD2) on PA5
 */
static const struct gpio_dt_spec ledGpio = GPIO_DT_SPEC_GET(LED0_NODE, gpios);

/* Global LED state */
static enum LedMode currentMode = LED_MODE_FLASHING;
static int flashPeriodMs = 1000;

int gpioHandlerInit(void)
{
	int ret;

	if (!gpio_is_ready_dt(&ledGpio)) {
		printk("Error: LED GPIO device not ready\n");
		return -1;
	}

	ret = gpio_pin_configure_dt(&ledGpio, GPIO_OUTPUT_ACTIVE);
	if (ret < 0) {
		printk("Error: Failed to configure LED GPIO\n");
		return -1;
	}

	printk("GPIO Handler initialized: %s pin %d\n", ledGpio.port->name, ledGpio.pin);
	return 0;
}

void gpioHandlerSetMode(enum LedMode mode)
{
	currentMode = mode;

	/* Immediately set LED state for ON/OFF modes */
	if (mode == LED_MODE_ON) {
		gpio_pin_set_dt(&ledGpio, 1);
	} else if (mode == LED_MODE_OFF) {
		gpio_pin_set_dt(&ledGpio, 0);
	}
}

enum LedMode gpioHandlerGetMode(void)
{
	return currentMode;
}

void gpioHandlerSetFlashPeriod(int periodMs)
{
	flashPeriodMs = periodMs;
}

int gpioHandlerGetFlashPeriod(void)
{
	return flashPeriodMs;
}

/* LED control thread */
void ledControlThread(void)
{
	bool ledState = false;

	while (1) {
		switch (currentMode) {
		case LED_MODE_OFF:
			/* LED is already off, just sleep */
			k_msleep(100);
			break;

		case LED_MODE_ON:
			/* LED is already on, just sleep */
			k_msleep(100);
			break;

		case LED_MODE_FLASHING:
			/* Toggle the LED */
			gpio_pin_toggle_dt(&ledGpio);
			ledState = !ledState;
			k_msleep(flashPeriodMs);
			break;
		}
	}
}

K_THREAD_DEFINE(ledThread, 1024, ledControlThread, NULL, NULL, NULL, 7, 0, 0);
```

## src/gpioHandler.h
```c
/*
 * Copyright (c) 2025
 * SPDX-License-Identifier: Apache-2.0
 */

#ifndef GPIO_HANDLER_H
#define GPIO_HANDLER_H

#include <zephyr/kernel.h>
#include <zephyr/drivers/gpio.h>

/* LED control modes */
enum LedMode {
	LED_MODE_OFF,
	LED_MODE_ON,
	LED_MODE_FLASHING
};

/**
 * @brief Initialize the GPIO LED
 * @return 0 on success, negative error code on failure
 */
int gpioHandlerInit(void);

/**
 * @brief Set the LED mode
 * @param mode The desired LED mode
 */
void gpioHandlerSetMode(enum LedMode mode);

/**
 * @brief Get the current LED mode
 * @return Current LED mode
 */
enum LedMode gpioHandlerGetMode(void);

/**
 * @brief Set the flash period for flashing mode
 * @param periodMs Flash period in milliseconds
 */
void gpioHandlerSetFlashPeriod(int periodMs);

/**
 * @brief Get the current flash period
 * @return Current flash period in milliseconds
 */
int gpioHandlerGetFlashPeriod(void);

/**
 * @brief LED control thread entry point (called by Zephyr)
 */
void ledControlThread(void);

#endif /* GPIO_HANDLER_H */
```
